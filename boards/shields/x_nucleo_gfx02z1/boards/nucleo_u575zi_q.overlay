/*
 * Copyright (c) 2026 Michele Vaccari
 *
 * SPDX-License-Identifier: Apache-2.0
 */

#include <freq.h>

&mx_flash {
	mspi-data-rate = "MSPI_DATA_RATE_SINGLE";
	mspi-io-mode = "MSPI_IO_MODE_QUAD";
};
