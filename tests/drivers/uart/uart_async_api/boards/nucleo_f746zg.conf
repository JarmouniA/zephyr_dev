## tests/drivers/uart/uart_async_api/boards/nucleo_f746zg.conf
```kconfig
# Not enough MPU regions when both CONFIG_USERSPACE and CONFIG_NOCACHE_MEMORY are set
CONFIG_USERSPACE=n

CONFIG_NOCACHE_MEMORY=y
CONFIG_UNCACHED_RAM="RAM_NOCACHE"
```
